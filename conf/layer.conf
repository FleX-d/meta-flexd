## conf/layer.conf
```bitbake
# We have a conf and classes directory, append to BBPATH
BBPATH .= ":${LAYERDIR}"

# We have a recipes directory, add to BBFILES
BBFILES += "${LAYERDIR}/recipes*/*/*.bb ${LAYERDIR}/recipes*/*/*.bbappend ${LAYERDIR}/images/*.bb"

BBFILE_COLLECTIONS += "meta-flexd"
BBFILE_PATTERN_meta-flexd := "^${LAYERDIR}/"
BBFILE_PRIORITY_meta-felxd = "7"

LAYERDEPENDS_mb = "core yocto openembedded-layer"
```
